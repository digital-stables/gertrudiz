
#include "Arduino.h"
#include <OLED.h>
#include <NoLCD.h>
#include <GroveLCD.h>
#include <I2CLCD.h>
#include <static_str.h>

#include <Wire.h> 

#include <LCD.h>


#include <DiscreteRecord.h>
#include <SDCardManager.h>
#include <avr/wdt.h>
#include <PowerManager.h>
#include <NoDataStorageManager.h>
#include <MemoryFree.h>


/**
 * teleonome speciifc libraries
 */
#include <MusicPlayerController.h>
#include <GertrudizControlPanelController.h>
#include <NetworkSensorController.h>

/**
 * teleonome speciifc variables
 */
GroveLCD musicPlayerLCD;
I2CLCD controPanelLCD;

//I2CLCD musicPlayerLCD;
// GroveLCD controPanelLCD;
static const char *LIFE_CYCLE_EVENT_SETUP_COMPLETED="Setup Method Completed";
static const int LIFE_CYCLE_EVENT_COMMA_VALUE=1;

DataStorageManagerInitParams dataStorageManagerInitParams;

TimeManager timeManager(Serial);
SecretManager secretManager(timeManager);
//NoDataStorageManager dataStorageManager( dataStorageManagerInitParams, timeManager, generalFunctions, Serial, controPanelLCD);
SDCardManager dataStorageManager( dataStorageManagerInitParams, timeManager, Serial, controPanelLCD );
PowerManager aPowerManager(controPanelLCD , secretManager , dataStorageManager , timeManager, Serial);


/**
 * Teleonome Specific Functions
 *  Generated by the Spermatogenesis process
 */
MusicPlayerController aMusicPlayerController(Serial,musicPlayerLCD);
GertrudizControlPanelController aGertrudizControlPanelController(controPanelLCD, aPowerManager,Serial );
NetworkSensorController aNetworkSensorController(Serial);




/**
 * End of Teleonome Specific Functions
 */




/***************************************************
 *  Name:        ISR(WDT_vect)
 *
 *  Returns:     Nothing.
 *
 *  Parameters:  None.
 *
 *  Description: Watchdog Interrupt Service. This
 *               is executed when watchdog timed out.
 *
 ***************************************************/
ISR(WDT_vect){
  controPanelLCD.setCursor(0, 1);
  controPanelLCD.print("Waking Up") ;
  wdt_reset();

  // uncomment
  aPowerManager.toggleWDT();
//    if(f_wdt == 0)
//    {
//      f_wdt=1;
//    }
//    else
//    {
//      //_HardSerial.println("WDT Overrun!!!");
//    }
}

void setup() {

// analogReference(INTERNAL1V1);
controPanelLCD.begin();
musicPlayerLCD.begin();

aPowerManager.start();

  int numberOfStations=5;
  aNetworkSensorController.start();
  aMusicPlayerController.start(numberOfStations);
  aGertrudizControlPanelController.start();

  
  
 
     
  //
  // Start the Serial Ports
  //
  Serial.begin(9600);
  
    
  
  

  //  //
  //  // Start The Managers
  //  //
  controPanelLCD.setCursor(0, 0);
  controPanelLCD.clear();
  controPanelLCD.print("Init Time Manager") ;
  controPanelLCD.setCursor(0, 1);
  controPanelLCD.print("1 of 3") ;
timeManager.start();
//  //
  controPanelLCD.clear();
  controPanelLCD.setCursor(0, 0);
  controPanelLCD.print("Init SDCard Manager2") ;
  controPanelLCD.setCursor(0, 1);
  controPanelLCD.print("2 of 3") ;
//// // 
  dataStorageManager.start();
////  //
  controPanelLCD.clear();
  controPanelLCD.setCursor(0, 0);
  controPanelLCD.print("Init Power Manager2") ;
  controPanelLCD.setCursor(0, 1);
  controPanelLCD.print("3 of 3") ;
 // aPowerManager.start();
//  //
  long totalDiskUse=dataStorageManager.getDiskUsage()/1024;
//
  //
  // end of initializing controPanelLCD
  //
  

  dataStorageManager.storeLifeCycleEvent(timeManager.getCurrentTimeInSeconds(), LIFE_CYCLE_EVENT_SETUP_COMPLETED, LIFE_CYCLE_EVENT_COMMA_VALUE);

   controPanelLCD.clear();
  controPanelLCD.setCursor(0, 1);
  controPanelLCD.println("Finish Init") ;
  controPanelLCD.setCursor(0, 2);
  controPanelLCD.print(" ") ;

}


void loop() {

 
  
  wdt_reset();


aGertrudizControlPanelController.checkStatus(  );
aMusicPlayerController.checkStatus(  );
 
aPowerManager.defineState();
 

  if( Serial.available() != 0) {
    
    String command = Serial.readString();
    //
    // end of teleonome specific sensors
    //
    boolean commandProcessed = aPowerManager.processDefaultCommands( command);
   
    /*
     * teleonome specific sensors
     */

    /*
     * end  f teleonome specific sensors
     */
    if(!commandProcessed){
      //
      // add device specific
      if(command.startsWith(F("SetStations"))){
        int numberStations = GeneralFunctions::getValue(command, '#', 1).toInt();
        aMusicPlayerController.setNumberOfStations(numberStations);
         
      }else if(command.startsWith(F("SetQoS"))){
        int download = GeneralFunctions::getValue(command, '#', 1).toInt();
        int upload = GeneralFunctions::getValue(command, '#', 2).toInt();
        aNetworkSensorController.setQoS(download, upload);
         Serial.println("Ok-SetQoS");
        Serial.flush();
      }else if(command.startsWith(F("SetIntrusionStatusColor"))){
        //SetIntrusionStatusColor#1#148#0#211#
        int pin = GeneralFunctions::getValue(command, '#', 1).toInt();
        int red = GeneralFunctions::getValue(command, '#', 2).toInt();
        int green = GeneralFunctions::getValue(command, '#', 3).toInt();
        int blue = GeneralFunctions::getValue(command, '#', 4).toInt();
        
        aNetworkSensorController.setNetworkStatusColor(pin,  red,  green,  blue );
       // aNetworkSensorController.setNetworkStatusColor(1,  red,  green,  blue );
        
          Serial.print("Ok-SetIntrusionStatusColor#");
          Serial.println(red);
        Serial.flush();
      }else if(command.startsWith(F("SetIntrusionStatus"))){
        // SetIntrusionStatus#success#danger#  <-- last # is necessary
        String value0 = GeneralFunctions::getValue(command, '#', 1);
        String value1 = GeneralFunctions::getValue(command, '#', 2);
        aNetworkSensorController.setNetworkStatusColor(0,value0);
        aNetworkSensorController.setNetworkStatusColor(1,value1);
          Serial.println("Ok-SetIntrusionStatus#");
//          Serial.print(pin);
//           Serial.print("#" );
//           Serial.println(value);
        Serial.flush();
      }else if(command.startsWith(F("GetSensorData"))){
        
        aPowerManager.printBaseSensorStringToSerialPort();
       
        //
        // now add the teleonome specific sensors
        //
        Serial.println(" ");
        Serial.flush();
       
      }else if(command.startsWith(F("ReadDiscreteRecords"))){
        boolean fileOk = dataStorageManager.openDiscreteRecordFile();
        boolean keepGoing=true;
        DiscreteRecord discreteRecord;

        uint16_t index=0;
        if(fileOk){
          while(keepGoing){
            keepGoing = dataStorageManager.readDiscreteRecord(index, discreteRecord);
            index++;
            if(keepGoing){
              //
              // if we are here is because we do have data
              // so extract it
              //
              // generated code
              //
             
              Serial.print(discreteRecord.timestamp) ;
              Serial.print("#") ;
              Serial.print(discreteRecord.lat) ;
              Serial.print("#") ;
              Serial.print(discreteRecord.lon) ;
              Serial.print("#") ;
              Serial.print(discreteRecord.panID) ;
              Serial.print("#") ;
              Serial.print(discreteRecord.tagId) ;
              Serial.print("#") ;
              Serial.print(discreteRecord.signalStrength) ;
             Serial.println("#") ;
             
            }
            Serial.println("Ok-RD");
            Serial.flush();
          }
          //sdCardManager.closeDiscreteRecordFile();
        }
      }else if(command.startsWith(F("TurnUSBPortOn"))){
         aGertrudizControlPanelController.turnSpeakerUSBPortOn();
         Serial.println(F("Ok-TurnUSBPortOn"));
         Serial.flush();
      }else if(command.startsWith(F("TurnUSBPortOff"))){
          aGertrudizControlPanelController.turnSpeakerUSBPortOff();
         Serial.println(F("Ok-TurnUSBPortOff"));
         Serial.flush();
      }else if(command.startsWith(F("TurnPhoneUSBPortOn"))){
          aGertrudizControlPanelController.turnPhoneUSBPortOn();
        Serial.println(F("Ok-TurnPhoneUSBPortOn"));
         Serial.flush();
      }else if(command.startsWith(F("TurnPhoneUSBPortOff"))){
        aGertrudizControlPanelController.turnPhoneUSBPortOff();
       Serial.println(F("Ok-TurnPhoneUSBPortOff"));
         Serial.flush();
      }else if(command.startsWith(F("TurnPiOn"))){
         long now = timeManager.getCurrentTimeInSeconds();
          aPowerManager.turnPiOn(now);

       Serial.println(F("Ok-TurnPiOn"));
         Serial.flush();
      }else if(command.startsWith(F("TurnPiOff"))){
         long now = timeManager.getCurrentTimeInSeconds();
          aPowerManager.turnPiOff(now);
       
       Serial.println(F("Ok-TurnPiOff"));
         Serial.flush();
      }else if (command.startsWith("UserCommand") ){
       boolean moreCommands=true;
       while(moreCommands){
          moreCommands = aMusicPlayerController.getNextUserCommand();
       }
        Serial.println("Ok-UserCommand");
        Serial.flush();       
    }else{
        //
        // call read to flush the incoming
        //
        Serial.read();
        Serial.println("Failure-Bad Command " + command);
        Serial.flush();
      }
      
  }
    }

    // this is the end of the loop, to calculate the energy spent on this loop
    // take the time substract the time at the beginning of the loop (the now variable defined above)
    // and also substract the seconds spent in powerdownMode
    // finally add the poweredDownInLoopSeconds to the daily total

    aPowerManager.endOfLoopProcessing();

  }
